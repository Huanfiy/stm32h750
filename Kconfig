## Kconfig
```kconfig
mainmenu "RT-Thread Configuration"

config BSP_DIR
    string
    default "."

config RTT_DIR
    string
    # Keep the default on the fourth line for RT-Thread Env fallback parsing.
    default "../../.."

config PKGS_DIR
    string
    default "packages"

source "$RTT_DIR/Kconfig"
source "$PKGS_DIR/Kconfig"
source "libraries/Kconfig"
source "board/Kconfig"
```
